## CMakeLists.txt
```
#
# Copyright (c) 2020 Nordic Semiconductor ASA
#
# SPDX-License-Identifier: LicenseRef-Nordic-5-Clause
#
cmake_minimum_required(VERSION 3.20.0)

find_package(Zephyr REQUIRED HINTS $ENV{ZEPHYR_BASE})

project(openthread_coap_client)

# NORDIC SDK APP START
target_sources(app PRIVATE src/main.c src/ot_coap_client.c
			   src/coap_client.c src/openthread.c)

target_include_directories(app PUBLIC coap_server/interface)
# NORDIC SDK APP END

target_sources_ifdef(CONFIG_BT_NUS app PRIVATE src/ble_utils.c)
```

## prj.conf
```kconfig
#
# Copyright (c) 2020 Nordic Semiconductor
#
# SPDX-License-Identifier: LicenseRef-Nordic-5-Clause
#

# nRF board library
CONFIG_DK_LIBRARY=y

# Enable CoAP utils and CoAP protocol
CONFIG_COAP_UTILS=y

# Enable OpenThread CoAP support API
CONFIG_OPENTHREAD_COAP=y

# Generic networking options
CONFIG_NETWORKING=y

# L2 OpenThread enabling
CONFIG_NET_L2_OPENTHREAD=y

# Network shell
CONFIG_SHELL=y
CONFIG_OPENTHREAD_SHELL=y
CONFIG_SHELL_ARGC_MAX=26
CONFIG_SHELL_CMD_BUFF_SIZE=416

# Network sockets
CONFIG_NET_SOCKETS=y
CONFIG_NET_SOCKETS_POSIX_NAMES=y
CONFIG_NET_SOCKETS_POLL_MAX=4

# Same network Master Key for client and server
CONFIG_OPENTHREAD_NETWORKKEY="00:11:22:33:44:55:66:77:88:99:aa:bb:cc:dd:ee:ff"

CONFIG_MBEDTLS_SHA1_C=n
CONFIG_FPU=y

CONFIG_NRF_802154_SER_HOST=y
CONFIG_NRF_CC3XX_PLATFORM=y
CONFIG_OPENAMP=y
CONFIG_CONSOLE_INIT_PRIORITY=60
CONFIG_COMMON_LIBC_MALLOC=n
CONFIG_ONOFF=y
CONFIG_IPC_SERVICE_RPMSG=y
CONFIG_IPC_SERVICE_STATIC_VRINGS=y
CONFIG_COMPILER_FREESTANDING=n
CONFIG_FORTIFY_SOURCE_COMPILE_TIME=y
CONFIG_OPENTHREAD_MTD=y

# Configure sample logging setting
CONFIG_LOG=y
CONFIG_SYSTEM_WORKQUEUE_STACK_SIZE=4096
```

## src/main.c
```c
#include <zephyr/kernel.h>
#include <dk_buttons_and_leds.h>
#include <zephyr/logging/log.h>
#include <zephyr/net/openthread.h>
#include <openthread/thread.h>

// #include "coap_client.h"
#include "ot_coap_client.h"
#include "openthread.h"

LOG_MODULE_REGISTER(coap_client);

int main(void)
{
	int ret;

	LOG_INF("Start CoAP-client sample");

	ret = dk_leds_init();
	if (ret)
	{
		LOG_ERR("Cannot init leds, (error: %d)", ret);
		return 0;
	}

	openthread_init();

	// coap_client_init();

	// uint8_t state = 48;
	// while (1)
	// {
	// 	/* code */
	// 	LOG_INF("Send multicast mesh 'light' request");
	// 	if (state == 49)
	// 	{
	// 		state = 48;
	// 	}
	// 	else
	// 	{
	// 		state = 49;
	// 	}

	// 	printk("state : %d\n", state);

	// 	char *payload = "{\"user\" : \"nrf5340\",\"senor_01\" : 4.56,\"senor_02\" : 100,\"senor_03\" : 220}";

	// 	coap_send_data(payload);

	// 	k_msleep(1000);
	// }

	// Initialize CoAP server settings
	struct ot_coap_client_settings coap_settings = {
		.coap_uri_path = NULL,
		.coap_port = 5683, // #default 5683, You can replace it with your desired port
	};

	ret = ot_coap_client_init(&coap_settings);
	if (ret)
	{
		LOG_ERR("Could not initialize OpenThread CoAP");
		goto end;
	}

	while (1)
	{
		coap_send_data_request("data", "hello world");
		k_msleep(1000);
	}

end:
	return 0;
}
```

## src/coap_client.c
```c
/*
 * Copyright (c) 2020 Nordic Semiconductor ASA
 *
 * SPDX-License-Identifier: LicenseRef-Nordic-5-Clause
 */

#include <zephyr/kernel.h>
#include <net/coap_utils.h>
#include <zephyr/logging/log.h>
#include <zephyr/net/openthread.h>
#include <zephyr/net/socket.h>
#include <openthread/thread.h>

#include "coap_client.h"

#define COAP_PORT 5683

/**@brief Enumeration describing light commands. */
enum light_command
{
	THREAD_COAP_UTILS_LIGHT_CMD_OFF = '0',
	THREAD_COAP_UTILS_LIGHT_CMD_ON = '1',
	THREAD_COAP_UTILS_LIGHT_CMD_TOGGLE = '2'
};

#define PROVISIONING_URI_PATH "provisioning"
#define LIGHT_URI_PATH "data"

LOG_MODULE_REGISTER(coap_client_utils, CONFIG_COAP_CLIENT_UTILS_LOG_LEVEL);

/* Options supported by the server */
static const char *const light_option[] = {LIGHT_URI_PATH, NULL};

/* Thread multicast mesh local address */
static struct sockaddr_in6 multicast_local_addr = {
	.sin6_family = AF_INET6,
	.sin6_port = htons(COAP_PORT),
	.sin6_addr.s6_addr = {0xff, 0x03, 0x00, 0x00, 0x00, 0x00, 0x00, 0x00,
						  0x00, 0x00, 0x00, 0x00, 0x00, 0x00, 0x00, 0x01},
	.sin6_scope_id = 0U};

void coap_client_init()
{
	coap_init(AF_INET6, NULL);
}

void coap_send_data(uint8_t *payload)
{
	printk("Payload: %s , %zu\n", payload, strlen(payload));

	coap_send_request(COAP_METHOD_PUT,
					  (const struct sockaddr *)&multicast_local_addr,
					  light_option, payload, strlen(payload), NULL);
}
```

## src/coap_client.h
```c
/**
 * @file
 * @defgroup coap_client_utils API for coap_client_* samples
 * @{
 */

/*
 * Copyright (c) 2020 Nordic Semiconductor ASA
 *
 * SPDX-License-Identifier: LicenseRef-Nordic-5-Clause
 */

#ifndef __COAP_CLIENT_UTILS_H__
#define __COAP_CLIENT_UTILS_H__

/** @brief Initialize CoAP client utilities.
 */
void coap_client_init();

/** @brief Send data through CoAP
 */
void coap_send_data(uint8_t *payload);

#endif

/**
 * @}
 */
```

## src/openthread.h
```c
#ifndef _OPENTHREAD_CLIENT_H
#define _OPENTHREAD_CLIENT_H

void openthread_init();

#endif
```

## src/ot_coap_client.c
```c
#include <zephyr/logging/log.h>
#include <zephyr/net/net_pkt.h>
#include <zephyr/net/net_l2.h>
#include <zephyr/net/openthread.h>
#include <openthread/coap.h>
#include <openthread/ip6.h>
#include <openthread/message.h>
#include <openthread/thread.h>

#include "ot_coap_client.h"

LOG_MODULE_REGISTER(ot_coap_client);

struct client_context
{
	struct otInstance *ot;
};

static struct client_context clt_context = {
	.ot = NULL};

static otCoapResource coap_resource = {
	.mUriPath = NULL,
	.mHandler = NULL,
	.mContext = NULL,
	.mNext = NULL,
};

static struct ot_coap_client_get_payload payload = {
	.buffer = "",
	.length = 0,
};

void coap_send_data_request(char *uri_path, char *payload)
{
	otError error = OT_ERROR_NONE;
	otMessage *myMessage;
	otMessageInfo myMessageInfo;
	otInstance *myInstance = openthread_get_default_instance();

	const otMeshLocalPrefix *ml_prefix = otThreadGetMeshLocalPrefix(myInstance);
	uint8_t serverInterfaceID[8] = {0x00, 0x00, 0x00, 0x00, 0x00, 0x00, 0x00, 0x01};

	do
	{
		myMessage = otCoapNewMessage(myInstance, NULL);
		if (myMessage == NULL)
		{
			printk("Failed to allocate message for CoAP Request\n");
			return;
		}
		// otCoapMessageInit(myMessage, OT_COAP_TYPE_CONFIRMABLE, OT_COAP_CODE_PUT);
		otCoapMessageInit(myMessage, OT_COAP_TYPE_NON_CONFIRMABLE, OT_COAP_CODE_PUT);

		error = otCoapMessageAppendUriPathOptions(myMessage, uri_path);
		if (error != OT_ERROR_NONE)
		{
			printk("Failed - otCoapMessageAppendUriPathOptions: %d\n", error);
			break;
		}

		error = otCoapMessageAppendContentFormatOption(myMessage, OT_COAP_OPTION_CONTENT_FORMAT_JSON);
		if (error != OT_ERROR_NONE)
		{
			printk("Failed - otCoapMessageAppendContentFormatOption: %d\n", error);
			break;
		}

		error = otCoapMessageSetPayloadMarker(myMessage);
		if (error != OT_ERROR_NONE)
		{
			printk("Failed - otCoapMessageSetPayloadMarker: %d\n", error);
			break;
		}

		error = otMessageAppend(myMessage, payload, strlen(payload));
		if (error != OT_ERROR_NONE)
		{
			printk("Failed - otMessageAppend: %d\n", error);
			break;
		}

		memset(&myMessageInfo, 0, sizeof(myMessageInfo));
		memcpy(&myMessageInfo.mPeerAddr.mFields.m8[0], ml_prefix, 8);
		memcpy(&myMessageInfo.mPeerAddr.mFields.m8[8], serverInterfaceID, 8);
		myMessageInfo.mPeerPort = OT_DEFAULT_COAP_PORT;

		// error = otCoapSendRequest(myInstance, myMessage, &myMessageInfo, coap_send_data_response_cb, NULL);
		error = otCoapSendRequest(myInstance, myMessage, &myMessageInfo, NULL, NULL);

	} while (false);

	if (error != OT_ERROR_NONE)
	{
		printk("Failed to send CoAP Request: %d\n", error);
		otMessageFree(myMessage);
	}
	else
	{
		printk("Coap data send.\n");
	}
}

static void CoAP_request_handler(void *context, otMessage *message, const otMessageInfo *message_info)
{

	ARG_UNUSED(context);

	if ((otCoapMessageGetType(message) != OT_COAP_TYPE_CONFIRMABLE) && (otCoapMessageGetType(message) != OT_COAP_TYPE_NON_CONFIRMABLE))
	{
		LOG_ERR("CoAP handler - Unexpected type of message");
		goto end;
	}

	if ((otCoapMessageGetCode(message) != OT_COAP_CODE_PUT) && (otCoapMessageGetCode(message) != OT_COAP_CODE_POST))
	{
		LOG_ERR("CoAP handler - Unexpected CoAP code");
		goto end;
	}

	payload.length = otMessageRead(message, otMessageGetOffset(message), payload.buffer, PAYLOAD_SIZE - 1);

	if (payload.length > 0)
	{
		payload.buffer[payload.length] = '\0';
		LOG_INF("CoAP message: %s , %d", payload.buffer, payload.length);
	}
	else
	{
		LOG_ERR("Error reading payload");
	}

	if (otCoapMessageGetType(message) == OT_COAP_TYPE_CONFIRMABLE)
	{
		// storedata_response_send(message, message_info);
	}
end:
	return;
}

static void CoAP_default_handler(void *context, otMessage *message, const otMessageInfo *message_info)
{
	ARG_UNUSED(context);
	ARG_UNUSED(message);
	ARG_UNUSED(message_info);

	LOG_INF("Received CoAP message that does not match any request or resource");
}

int ot_coap_client_init(struct ot_coap_client_settings *settings)
{
	otError error;

	clt_context.ot = openthread_get_default_instance();
	if (!clt_context.ot)
	{
		LOG_ERR("There is no valid OpenThread instance");
		error = OT_ERROR_FAILED;
		goto end;
	}

	coap_resource.mUriPath = settings->coap_uri_path;
	coap_resource.mHandler = CoAP_request_handler;
	coap_resource.mContext = clt_context.ot;

	otCoapSetDefaultHandler(clt_context.ot, CoAP_default_handler, NULL);
	otCoapAddResource(clt_context.ot, &coap_resource);

	error = otCoapStart(clt_context.ot, settings->coap_port);
	if (error != OT_ERROR_NONE)
	{
		LOG_ERR("Failed to start OT CoAP. Error: %d", error);
		goto end;
	}

end:
	return error == OT_ERROR_NONE ? 0 : 1;
}
```

## src/ot_coap_client.h
```c
#ifndef __OT_COAP_CLIENT_H__
#define __OT_COAP_CLIENT_H__

#include <stdint.h>

#define PAYLOAD_SIZE 256

struct ot_coap_client_get_payload
{
    char buffer[PAYLOAD_SIZE];
    uint16_t length;
};

struct ot_coap_client_settings
{
    const char *coap_uri_path;
    uint16_t coap_port;
};

int ot_coap_client_init(struct ot_coap_client_settings *settings);
void coap_send_data_request(char *uri_path, char *payload);
#endif
```
